/*
 * hillside46rolling.keymap
 *
 * © 2025 René Wihan
 */

#include <behaviors.dtsi>
#include <dt-bindings/zmk/bt.h>
#include <dt-bindings/zmk/ext_power.h>
#include <dt-bindings/zmk/keys.h>
#include <dt-bindings/zmk/outputs.h>
//#include <dt-bindings/zmk/pointing.h>
#include "utf8_bindings.h"

#define KLEIN 0
#define GROSS 1
#define ZAHL1 2
#define ZAHL2 3
#define NAVI1 4
#define NAVI2 5
#define MOUSE 6
#define SONDR 7
#define FUNKT 8

#define Undo   LC(Z)
#define Cut    LC(X)
#define Copy   LC(C)
#define Paste  LC(V)
#define Redo   LC(Y)

/ {

    keymap {
        compatible = "zmk,keyboard";
        label = "Hillside46 Rolling Layout";

    // --------------------------------------------------
    // KLEIN: ⇩ - Kleinbuchstaben
    // --------------------------------------------------
        KLEIN {
            display-name = "⇩ Kleinbuchstaben";
            bindings = <
        &kp Q      &kp W  &kp K  &kp Z    &kp D    &kp P                                &kp O         &kp G      &kp L   &kp M       &kp SQT     &kp PLUS
        &kp TAB    &kp H  &kp C  &kp S    &kp T    &kp U                                &kp R         &kp I      &kp E   &kp N       &kp A       &kp SLASH
        &kp LCTRL  &kp V  &kp X  &kp Y    &kp F    &kp DOT    &to MOUSE      &kp RALT   &kp BACKSPACE &kp B      &kp J   &wr_test /*U_0308*/      &kp MINUS   &kp COLON
                                 &kp LGUI &kp LALT &mo GROSS  &kp SPC        &kp ENTER  &mo ZAHL1     &mo NAVI1  &mo SONDR
            >;
        };
/*
    // --------------------------------------------------
    // GROSS: ⇧ - Großbuchstaben
    // --------------------------------------------------
        GROSS {
            display-name = "⇧ Großbuchstaben";
            bindings = <
        &kp Q        &kp W  &kp K  &kp Z    &kp D    &kp P                                 &kp O       &kp G      &kp L      &kp M       &kp DQT    &kp ASTERISK
        &kp LS(TAB)  &kp H  &kp C  &kp S    &kp T    &kp U                                 &kp R       &kp I      &kp E      &kp N       &kp A      &kp BSLH
        &kp LCTRL    &kp V  &kp X  &kp Y    &kp F    &kp COMMA  &to MOUSE      &kp RALT    &kp DELETE  &kp B      &kp J      &kp U_0308  &kp MINUS  &kp SEMI
                                 &kp LGUI &kp LALT &mo KLEIN  &kp SPC        &kp ENTER   &mo ZAHL2   &mo NAVI2  &mo FUNKT
            >;
        };

    // --------------------------------------------------
    // ZAHL1: № - Zahlen / Klammern
    // --------------------------------------------------
        ZAHL1 {
            display-name = "№ Zahlen & Klammern";
            bindings = <
        &kp GRAVE  &kp KP_N1  &kp KP_N2  &kp KP_N3   &kp KP_N4  &kp KP_N5                          &kp KP_N6  &kp KP_N7  &kp KP_N8   &kp KP_N9   &kp KP_N0  &kp CIRCUMFLEX
        &none      &kp LT     &kp LBKT   &kp LBRACE  &kp LPAR   &none                              &none      &kp RPAR   &kp RBRACE  &kp RBKT    &kp GT     &kp PIPE
        &kp LCTRL  &none      &none      &none       &none      &kp COMMA  &to MOUSE     &none     &none      &none      &none       &kp U_0301  &kp EQL    &kp QMARK
                                         &kp LGUI    &kp LALT   &mo GROSS  &kp SPC       &kp ENTER &mo ZAHL1  &mo NAVI1  &mo SONDR
            >;
        };

    // --------------------------------------------------
    // ZAHL2: ⇧ + № - Zahlen, Erweiterung (Sup, Sub, Brüche)
    // --------------------------------------------------
        ZAHL2 {
            display-name = "⇧№ Zahlen, erweitert";
            bindings = <
        &none      &kp U_00B9  &kp U_00B2  &kp U_00B3  &kp U_2074  &kp U_2075                         &kp U_2076  &kp U_2077  &kp U_2078  &kp U_2079  &kp U_2070  &kp TILDE
        &none      &kp U_215F  &kp U_00BC  &kp U_00BD  &kp U_2154  &kp U_00BE                         &none       &none       &none       &none       &none       &none
        &kp LCTRL  &kp U_2081  &kp U_2082  &kp U_2083  &kp U_2084  &kp U_2085 &to MOUSE    &none      &kp U_2086  &kp U_2087  &kp U_2088  &kp U_2089  &kp NO_1    &kp EXCL
                                           &kp LGUI    &kp LALT    &mo KLEIN  &kp SPC      &kp ENTER  &mo ZAHL1   &mo NAVI1   &mo SONDR
            >;
        };

    // --------------------------------------------------
    // NAVI1: ⎈ - Navigation
    // --------------------------------------------------
        NAVI1 {
            display-name = "⎈ Navigation";
            bindings = <
        &none      &none  &none     &none     &none     &none                             &kp PG_UP    &kp HOME   &none      &none           &none      &none
        &none      &none  &none     &none     &none     &none                             &none        &kp LEFT   &kp UP     &kp DOWN        &kp RIGHT  &none
        &kp LCTRL  &none  &none     &none     &none     &none      &to MOUSE     &none    &kp PG_DN    &kp END    &none      &kp MUTE_GRAVE  &none      &none
                                    &kp LGUI  &kp LALT  &mo GROSS  &kp SPC       &kp ENTER  &mo ZAHL1  &mo NAVI1  &mo SONDR
            >;
        };

    // --------------------------------------------------
    // NAVI2: ⇧ + ⎈ - Navigation, (Rahmen, Pfeile)
    // --------------------------------------------------
        NAVI2 {
            display-name = "⇧⎈ Rahmen & Pfeile";
            bindings = <
        &none  &kp U_2554  &kp U_250C  &kp U_2500  &kp U_2510  &kp U_2557                            &none       &kp U_2196  &kp U_21D1  &kp U_21B0  &kp U_2197  &none
        &none  &kp U_251C  &kp U_253C  &kp U_2524  &kp U_2502  &kp U_2551                            &kp U_21D0  &kp U_2190  &kp U_2191  &kp U_2193  &kp U_2192  &kp U_21D2
        &none  &kp U_255A  &kp U_2514  &kp U_2500  &kp U_2518  &kp U_255D  &to MOUSE      &none      &none       &kp U_2199  &kp U_21D3  &kp U_21B2  &kp U_2198  &none
                                       &kp LGUI    &kp LALT    &mo KLEIN   &kp SPC        &kp ENTER  &mo ZAHL1   &mo NAVI1   &mo SONDR
            >;
        };

    // --------------------------------------------------
    // MOUSE: 🖱 - Maussteuerung
    // --------------------------------------------------
        MOUSE {
            display-name = "🖱 Maussteuerung";
            bindings = <
        &none      &none  &none  &none  &none  &none                                   &mkp MB5   &msc SCRL_UP    &msc SCRL_LEFT  &msc SCRL_RIGHT  &none            &none
        &none      &none  &none  &none  &none  &none                                   &none      &mmv MOVE_LEFT  &mmv MOVE_UP    &mmv MOVE_DOWN   &mmv MOVE_RIGHT  &none
        &kp LCTRL  &none  &none  &none  &none  &none       &to KLEIN        &none      &mkp MB4   &msc SCRL_DOWN  &none           &none            &none            &none
                                 &none  &none  &kp LSHIFT  &none            &mkp LCLK  &mkp MCLK  &mkp RCLK       &none
            >;
        };

    // --------------------------------------------------
    // SONDR: ☍ - Sonderzeichen
    // --------------------------------------------------
        SONDR {
            display-name = "☍ Sonderzeichen";
            bindings = <
        &kp U_03B1  &kp U_03B2  &kp U_03B3  &kp U_03B4  &kp U_00A7  &kp PERCENT                              &kp U_03A9 &kp U_0394  &kp U_03A3  &kp U_00B5 &kp U_201E  &kp U_201C
        &none       &none       &kp U_00A9  &none       &none       &kp AMPERSAND                            &kp U_2611 &kp U_2610  &kp U_20AC  &none      &kp AT      &kp HASH
        &none       &none       &none       &none       &kp DOLLAR  &kp U_2026     &to MOUSE      &none      &kp U_2612 &none       &none       &kp GRAVE  &kp UNDER   &kp U_2022
                                            &kp LGUI    &kp LALT    &mo FUNKT      &kp SPC        &kp ENTER  &mo ZAHL1  &mo NAVI1   &mo SONDR
            >;
        };

    // --------------------------------------------------
    // FUNKT: 𝑓 - Funktionen, Mediensteuerung
    // --------------------------------------------------
        FUNKT {
            display-name = "𝑓 Funktionen";
            bindings = <
        &kp C_PREV  &kp C_PLAY_PAUSE  &kp C_NEXT  &none     &none     &kp PRINTSCREEN                              &none      &none         &none      &none  &kp C_MUTE     &kp C_VOL_UP
        &none       &none             &none       &none     &none     &out OUT_USB                                 &none      &kp INSERT    &kp ESC    &none  &none          &none
        &none       &none             &none       &none     &none     &none            &to MOUSE        &none      &none      &out OUT_BLE  &none      &none  &&kp C_VOL_DN  &none
                                                  &kp LGUI  &kp LALT  &mo GROSS        &kp SPC          &kp ENTER  &mo ZAHL1  &mo NAVI1     &mo SONDR
             >;
        };
*/
    };
};
