## config/boards/shields/hillside46rolling/Kconfig.shield
```kconfig
# Copyright (c) 2021-2022 The ZMK Contributors
# SPDX-License-Identifier: MIT

config SHIELD_HILLSIDE46_LEFT
    def_bool $(shields_list_contains,hillside46rolling_left)

config SHIELD_HILLSIDE46_RIGHT
    def_bool $(shields_list_contains,hillside46rolling_right)
```

## config/west.yml
```yaml
manifest:
  remotes:
    - name: zmkfirmware
      url-base: https://github.com/zmkfirmware
  projects:
    - name: zmk
      remote: zmkfirmware
      revision: 8b38c3b536635d7a6226f9c5b8af22f46c5ebdb7
      import: app/west.yml
  self:
    path: config
```
